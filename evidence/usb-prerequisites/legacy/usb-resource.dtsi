		usb0: usb@11200000 {
			compatible = "mediatek,mt8163-usb20";
			reg = <0 0x11200000 0 0x10000>,
			      <0 0x11210000 0 0x10000>;
			interrupts = <GIC_SPI 72 IRQ_TYPE_LEVEL_LOW>;
			mode = <2>;
			multipoint = <1>;
			dyn_fifo = <1>;
			soft_con = <1>;
			dma = <1>;
			num_eps = <16>;
			dma_channels = <8>;
			clocks = <&apmixedsys CLK_APMIXED_UNIVPLL>,
				 <&infracfg CLK_INFRA_USB_MCU>,
				 <&infracfg CLK_INFRA_USB>,
				 <&infracfg CLK_INFRA_ICUSB>;
			clock-names = "usbpll", "usbmcu", "usb", "icusb";
		};

		usb1: usb@11270000 {
			compatible = "mediatek,mt8163-usb11";
